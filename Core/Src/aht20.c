/**
  * @file aht20.c
  * @brief AHT20温湿度传感器驱动实现
  * @author Generated by AI
  */

#include "aht20.h"
#include "main.h"
#include "i2c.h"
#include <math.h>

/**
  * @brief  读取AHT20状态字
  * @param  status: 指向状态字的指针
  * @retval HAL_StatusTypeDef: 操作结果
  */
HAL_StatusTypeDef AHT20_ReadStatus(uint8_t *status)
{
    return HAL_I2C_Master_Receive(&hi2c1, AHT20_READ_ADDR, status, 1, HAL_MAX_DELAY);
}

/**
  * @brief  发送AHT20命令
  * @param  cmd: 命令字节
  * @param  param1: 参数1
  * @param  param2: 参数2
  * @retval HAL_StatusTypeDef: 操作结果
  */
HAL_StatusTypeDef AHT20_WriteCmd(uint8_t cmd, uint8_t param1, uint8_t param2)
{
    uint8_t data[3] = {cmd, param1, param2};
    return HAL_I2C_Master_Transmit(&hi2c1, AHT20_WRITE_ADDR, data, 3, HAL_MAX_DELAY);
}

/**
  * @brief  读取AHT20数据
  * @param  buffer: 数据缓冲区
  * @param  len: 读取长度
  * @retval HAL_StatusTypeDef: 操作结果
  */
HAL_StatusTypeDef AHT20_ReadData(uint8_t *buffer, uint8_t len)
{
    return HAL_I2C_Master_Receive(&hi2c1, AHT20_READ_ADDR, buffer, len, HAL_MAX_DELAY);
}

/**
  * @brief  初始化AHT20传感器
  * @retval HAL_StatusTypeDef: 操作结果
  */
HAL_StatusTypeDef AHT20_Init(void)
{
    uint8_t status;

    // 上电等待40ms
    HAL_Delay(40);

    // 读取状态字，检查校准位
    if (AHT20_ReadStatus(&status) != HAL_OK) {
        return HAL_ERROR;
    }

    if (!(status & AHT20_STATUS_CAL)) {
        // 未校准，发送初始化命令
        if (AHT20_WriteCmd(AHT20_CMD_INIT, 0x08, 0x00) != HAL_OK) {
            return HAL_ERROR;
        }
        HAL_Delay(10);  // 初始化后等待
    }

    return HAL_OK;
}

/**
  * @brief  测量温湿度
  * @param  humidity: 指向湿度的指针
  * @param  temperature: 指向温度的指针
  * @retval HAL_StatusTypeDef: 操作结果
  */
HAL_StatusTypeDef AHT20_Measure(float *humidity, float *temperature)
{
    uint8_t buffer[6];
    uint32_t raw_humidity, raw_temperature;

    // 触发测量
    if (AHT20_WriteCmd(AHT20_CMD_MEASURE, 0x33, 0x00) != HAL_OK) {
        return HAL_ERROR;
    }

    // 等待75ms
    HAL_Delay(75);

    // 读取6字节数据
    if (AHT20_ReadData(buffer, 6) != HAL_OK) {
        return HAL_ERROR;
    }

    // 检查状态字，确认不忙
    if (buffer[0] & AHT20_STATUS_BUSY) {
        return HAL_ERROR;  // 仍在测量中
    }

    // 拼接20位湿度数据
    raw_humidity = ((uint32_t)buffer[1] << 12) | ((uint32_t)buffer[2] << 4) | (buffer[3] >> 4);

    // 拼接20位温度数据
    raw_temperature = ((uint32_t)(buffer[3] & 0x0F) << 16) | ((uint32_t)buffer[4] << 8) | buffer[5];

    // 计算相对湿度 (%)
    *humidity = ((float)raw_humidity / (1 << 20)) * 100.0f;

    // 计算温度 (°C)
    *temperature = ((float)raw_temperature / (1 << 20)) * 200.0f - 50.0f;

    return HAL_OK;
}